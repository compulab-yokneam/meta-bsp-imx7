## conf/layer.conf
```bitbake
# We have a conf and classes directory, append to BBPATH
BBPATH .= ":${LAYERDIR}"

# We have a recipes directory containing .bb and .bbappend files, add to BBFILES
BBFILES += "${LAYERDIR}/recipes-*/*/*.bb \
            ${LAYERDIR}/recipes-*/*/*.bbappend"

BBFILE_COLLECTIONS += "compulab-bsp-imx7"
BBFILE_PATTERN_compulab-bsp-imx7 := "^${LAYERDIR}/"
BBFILE_PRIORITY_compulab-bsp-imx7 = "9"

BBMASK += "meta-compulab/recipes-xfce"
BBMASK += "meta-compulab/recipes-kernel"
BBMASK += "meta-compulab/recipes-graphics"
BBMASK += ".*boundary.*"
BBMASK += "meta-compulab/recipes-bsp/u-boot/u-boot-fw-utils_%.bbappend"
BBMASK += "meta-compulab-bsp/meta-bsp/recipes-bsp/linux-firmware/linux-firmware_%.bbappend"
BBMASK += "meta-compulab-bsp/meta-desktop/recipes-desktop/cl-uboot/cl-uboot.bbappend"
BBMASK += "meta-compulab-bsp/meta-desktop/recipes-desktop/cl-deploy/cl-deploy.bbappend"

CORE_IMAGE_EXTRA_INSTALL += " kernel-modules "
CORE_IMAGE_EXTRA_INSTALL += "${@bb.utils.contains('DISTRO_CODENAME', 'dunfell', 'linux-firmware-imx-sdma-imx7d', 'firmware-imx-sdma', d)}"

HOSTTOOLS += " git-lfs "
HOSTTOOLS += " bison "

LAYERSERIES_COMPAT_compulab-bsp-imx7 = "sumo thud warrior zeus dunfell gatesgarth hardknott"

PREFERRED_PROVIDER_virtual/kernel_cl-som-imx7 = "linux-compulab"
PREFERRED_PROVIDER_virtual/bootloader_cl-som-imx7 = "u-boot-compulab"

IMAGE_FSTYPES = "wic.bmap wic.xz ext4.gz"
WKS_FILES = "imx-uboot-bootpart.wks.in"
```

## conf/machine/cl-som-imx7.conf
```bitbake
#@TYPE: Machine
#@NAME: CompuLab CL-SOM-iMX7 family
#@SOC: i.MX7D
#@DESCRIPTION: Machine configuration for CompuLab CL-SOM-iMX7 family
#@MAINTAINER: compulab@compulab.co.il

require compulab-imx7.inc
```

## conf/machine/compulab-imx7.inc
```bitbake
SOC_FAMILY = "mx7:mx7d"
MACHINEOVERRIDES =. "mx7:mx7d:"

require conf/machine/include/imx-base.inc
require conf/machine/include/arm/armv7a/tune-cortexa7.inc

IMX_DEFAULT_BSP = "nxp"

UBOOT_CONFIG ??= "sd"
UBOOT_CONFIG[sd] = "cl-som-imx7_defconfig,sdcard"

KERNEL_DEVICETREE += " \
	imx7d-cl-som-imx7.dtb \
	imx7d-sbc-imx7.dtb \
	imx7d-sbc-imx7-m4.dtb \
	imx7d-sbc-imx7-lvds.dtb \
	imx7d-sbc-iot-imx7.dtb \
	imx7d-sbc-iot-imx7-rs485-hdx.dtb \
	imx7d-sbc-iot-imx7-can.dtb \
"

IMAGE_BOOT_FILES = "zImage "
IMAGE_BOOT_FILES += " ${KERNEL_DEVICETREE} "

MACHINE_FEATURES += " alsa bluetooth serial usbhost wifi pci "

MACHINE_FIRMWARE = "linux-firmware-wl18xx \
			linux-firmware-iwlwifi-6000g2a-5 linux-firmware-iwlwifi-6000g2a-6 \
			linux-firmware-iwlwifi-6000g2b-5 linux-firmware-iwlwifi-6000g2b-6"


# Set Serial console
SERIAL_CONSOLE = "115200 ttymxc0"

IMAGE_INSTALL:append = " \
	kernel-image \
	kernel-modules \
	kernel-devicetree \
"
```
